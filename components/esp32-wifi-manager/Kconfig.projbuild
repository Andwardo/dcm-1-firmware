## components/esp32-wifi-manager/Kconfig.projbuild
```kconfig
menu "WiFi Manager Configuration"

config WIFI_SSID
    string "WiFi SSID"
    default "YourSSID"
    help
        WiFi network SSID

config WIFI_PASSWORD
    string "WiFi Password"
    default "YourPassword"
    help
        WiFi network password

endmenu
```

## components/mqtt_manager/Kconfig
```kconfig
menu "MQTT Manager Configuration"

config MQTT_BROKER_URI
    string "MQTT Broker URI"
    default "mqtts://your-broker.example.com"
    help
        The MQTT broker URI. Example: mqtts://example.com

config MQTT_TOPIC
    string "MQTT Publish Topic"
    default "/dcms/status"
    help
        Topic to publish device data to.

endmenu
```

## components/mqtt_manager/Kconfig.projbuild
```kconfig
# components/mqtt_manager/Kconfig.projbuild

menu "MQTT Manager Configuration"

config MQTT_URI
    string "MQTT Broker URI"
    default "mqtts://your-broker-url"
    help
        URI of the MQTT broker, e.g., mqtts://pgapi.net

config MQTT_TOPIC
    string "MQTT Topic"
    default "dcm/update"
    help
        MQTT topic to publish sensor state to

endmenu
```

## components/provisioning_manager/Kconfig
```kconfig
menu "Provisioning Manager Configuration"

# no user-configurable options yet

endmenu
```

## components/wifi_manager/Kconfig
```kconfig
menu "Wi-Fi Manager Configuration"

config WIFI_MANAGER_DEBUG
    bool "Enable Wi-Fi Manager debug logs"
    default n

endmenu
```

## sdkconfig.defaults
```kconfig
// sdkconfig.defaults (updated)

# Target Chip
CONFIG_IDF_TARGET="esp32s3"

# Enable Logging
CONFIG_LOG_DEFAULT_LEVEL_INFO=y
CONFIG_LOG_MAXIMUM_LEVEL_VERBOSE=y

# Wi-Fi
CONFIG_ESP_WIFI_ENABLED=y
CONFIG_ESP_WIFI_NVS_ENABLED=y
# Add your network credentials here:
CONFIG_WIFI_SSID="YOUR_WIFI_SSID"
CONFIG_WIFI_PASSWORD="YOUR_WIFI_PASSWORD"

# MQTT
CONFIG_MQTT_PROTOCOL_311=y
CONFIG_MQTT_TRANSPORT_SSL=y
CONFIG_MQTT_TRANSPORT_WEBSOCKET=n
# Broker URI and default topic:
CONFIG_MQTT_URI="mqtts://dev1.pgapi.net:8883"
CONFIG_MQTT_TOPIC="device/dcm1/data"

# FreeRTOS
CONFIG_FREERTOS_UNICORE=n
```
